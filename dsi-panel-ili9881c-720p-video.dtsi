/* Copyright (c) 2013, The Linux Foundation. All rights reserved.
 *
 * This program is free software; you can redistribute it and/or modify
 * it under the terms of the GNU General Public License version 2 and
 * only version 2 as published by the Free Software Foundation.
 *
 * This program is distributed in the hope that it will be useful,
 * but WITHOUT ANY WARRANTY; without even the implied warranty of
 * MERCHANTABILITY or FITNESS FOR A PARTICULAR PURPOSE.  See the
 * GNU General Public License for more details.
 */

/*---------------------------------------------------------------------------
 * This file is autogenerated file using gcdb parser. Please do not edit it.
 * Update input XML file to add a new entry or update variable in this file
 * VERSION = "1.0"
 *---------------------------------------------------------------------------*/
&mdss_mdp {
	dsi_ili9881c_720p_video: qcom,mdss_dsi_ili9881c_720p_video {
		qcom,mdss-dsi-panel-name = "ili9881c 720p video mode dsi panel";
		qcom,mdss-dsi-panel-controller = <&mdss_dsi0>;
		qcom,mdss-dsi-panel-type = "dsi_video_mode";
		qcom,mdss-dsi-panel-destination = "display_1";
		qcom,mdss-dsi-panel-framerate = <60>;
		qcom,mdss-dsi-virtual-channel-id = <0>;
		qcom,mdss-dsi-stream = <0>;
		qcom,mdss-dsi-panel-width = <720>;
		qcom,mdss-dsi-panel-height = <1280>;
		qcom,mdss-dsi-h-front-porch = <80>;
		qcom,mdss-dsi-h-back-porch = <92>;
		qcom,mdss-dsi-h-pulse-width = <33>;
		qcom,mdss-dsi-h-sync-skew = <0>;
		qcom,mdss-dsi-v-back-porch = <20>;
		qcom,mdss-dsi-v-front-porch = <18>;
		qcom,mdss-dsi-v-pulse-width = <2>;
		qcom,mdss-dsi-h-left-border = <0>;
		qcom,mdss-dsi-h-right-border = <0>;
		qcom,mdss-dsi-v-top-border = <0>;
		qcom,mdss-dsi-v-bottom-border = <0>;
		qcom,mdss-dsi-bpp = <24>;
		qcom,mdss-dsi-color-order = "rgb_swap_rgb";
		qcom,mdss-dsi-underflow-color = <0xff>;
		qcom,mdss-dsi-border-color = <0>;
		qcom,mdss-dsi-on-command = [39 01 00 00 00 00 04 FF 98 81 03
39 01 00 00 00 00 02 01 01
39 01 00 00 00 00 02 02 00
39 01 00 00 00 00 02 03 73
39 01 00 00 00 00 02 04 73
39 01 00 00 00 00 02 05 14
39 01 00 00 00 00 02 06 06
39 01 00 00 00 00 02 07 02
39 01 00 00 00 00 02 08 05
39 01 00 00 00 00 02 09 00
39 01 00 00 00 00 02 0A 0C
39 01 00 00 00 00 02 0B 00
39 01 00 00 00 00 02 0C 1C
39 01 00 00 00 00 02 0D 1C
39 01 00 00 00 00 02 0E 00
39 01 00 00 00 00 02 0F 0C
39 01 00 00 00 00 02 10 0C
39 01 00 00 00 00 02 11 01
39 01 00 00 00 00 02 12 01
39 01 00 00 00 00 02 13 1B
39 01 00 00 00 00 02 14 0B
39 01 00 00 00 00 02 15 00
39 01 00 00 00 00 02 16 00
39 01 00 00 00 00 02 17 00
39 01 00 00 00 00 02 18 00
39 01 00 00 00 00 02 19 00
39 01 00 00 00 00 02 1A 00
39 01 00 00 00 00 02 1B 00
39 01 00 00 00 00 02 1C 00
39 01 00 00 00 00 02 1D 00
39 01 00 00 00 00 02 1E C8
39 01 00 00 00 00 02 1F 80
39 01 00 00 00 00 02 20 02
39 01 00 00 00 00 02 21 00
39 01 00 00 00 00 02 22 02
39 01 00 00 00 00 02 23 00
39 01 00 00 00 00 02 24 00
39 01 00 00 00 00 02 25 00
39 01 00 00 00 00 02 26 00
39 01 00 00 00 00 02 27 00
39 01 00 00 00 00 02 28 FB
39 01 00 00 00 00 02 29 43
39 01 00 00 00 00 02 2A 00
39 01 00 00 00 00 02 2B 00
39 01 00 00 00 00 02 2C 07
39 01 00 00 00 00 02 2D 07
39 01 00 00 00 00 02 2E FF
39 01 00 00 00 00 02 2F FF
39 01 00 00 00 00 02 30 11
39 01 00 00 00 00 02 31 00
39 01 00 00 00 00 02 32 00
39 01 00 00 00 00 02 33 00
39 01 00 00 00 00 02 34 84
39 01 00 00 00 00 02 35 80
39 01 00 00 00 00 02 36 07
39 01 00 00 00 00 02 37 00
39 01 00 00 00 00 02 38 00
39 01 00 00 00 00 02 39 00
39 01 00 00 00 00 02 3A 00
39 01 00 00 00 00 02 3B 00
39 01 00 00 00 00 02 3C 00
39 01 00 00 00 00 02 3D 00
39 01 00 00 00 00 02 3E 00
39 01 00 00 00 00 02 3F 00
39 01 00 00 00 00 02 40 00
39 01 00 00 00 00 02 41 00
39 01 00 00 00 00 02 42 00
39 01 00 00 00 00 02 43 80
39 01 00 00 00 00 02 44 08
39 01 00 00 00 00 02 50 01
39 01 00 00 00 00 02 51 23
39 01 00 00 00 00 02 52 45
39 01 00 00 00 00 02 53 67
39 01 00 00 00 00 02 54 89
39 01 00 00 00 00 02 55 ab
39 01 00 00 00 00 02 56 01
39 01 00 00 00 00 02 57 23
39 01 00 00 00 00 02 58 45
39 01 00 00 00 00 02 59 67
39 01 00 00 00 00 02 5A 89
39 01 00 00 00 00 02 5B ab
39 01 00 00 00 00 02 5C cd
39 01 00 00 00 00 02 5D ef
39 01 00 00 00 00 02 5E 10
39 01 00 00 00 00 02 5F 02
39 01 00 00 00 00 02 60 02
39 01 00 00 00 00 02 61 02
39 01 00 00 00 00 02 62 02
39 01 00 00 00 00 02 63 02
39 01 00 00 00 00 02 64 02
39 01 00 00 00 00 02 65 02
39 01 00 00 00 00 02 66 08
39 01 00 00 00 00 02 67 09
39 01 00 00 00 00 02 68 02
39 01 00 00 00 00 02 69 10
39 01 00 00 00 00 02 6A 12
39 01 00 00 00 00 02 6B 11
39 01 00 00 00 00 02 6C 13
39 01 00 00 00 00 02 6D 0C
39 01 00 00 00 00 02 6E 0E
39 01 00 00 00 00 02 6F 0D
39 01 00 00 00 00 02 70 0F
39 01 00 00 00 00 02 71 06
39 01 00 00 00 00 02 72 07
39 01 00 00 00 00 02 73 02
39 01 00 00 00 00 02 74 02
39 01 00 00 00 00 02 75 02
39 01 00 00 00 00 02 76 02
39 01 00 00 00 00 02 77 02
39 01 00 00 00 00 02 78 02
39 01 00 00 00 00 02 79 02
39 01 00 00 00 00 02 7A 02
39 01 00 00 00 00 02 7B 02
39 01 00 00 00 00 02 7C 07
39 01 00 00 00 00 02 7D 06
39 01 00 00 00 00 02 7E 02
39 01 00 00 00 00 02 7F 11
39 01 00 00 00 00 02 80 13
39 01 00 00 00 00 02 81 10
39 01 00 00 00 00 02 82 12
39 01 00 00 00 00 02 83 0F
39 01 00 00 00 00 02 84 0d
39 01 00 00 00 00 02 85 0E
39 01 00 00 00 00 02 86 0C
39 01 00 00 00 00 02 87 09
39 01 00 00 00 00 02 88 08
39 01 00 00 00 00 02 89 02
39 01 00 00 00 00 02 8A 02
39 01 00 00 00 00 04 FF 98 81 04
39 01 00 00 00 00 02 6c 15
39 01 00 00 00 00 02 6e 2B
39 01 00 00 00 00 02 6f 35
39 01 00 00 00 00 02 3a a4
39 01 00 00 00 00 02 8d 1F
39 01 00 00 00 00 02 87 ba
39 01 00 00 00 00 02 26 76
39 01 00 00 00 00 02 b2 d1
39 01 00 00 00 00 04 FF 98 81 01
39 01 00 00 00 00 02 22 0a
39 01 00 00 00 00 02 31 0B
39 01 00 00 00 00 02 34 01
39 01 00 00 00 00 02 40 33
39 01 00 00 00 00 02 53 64
39 01 00 00 00 00 02 55 8F
39 01 00 00 00 00 02 50 F1
39 01 00 00 00 00 02 51 F1
39 01 00 00 00 00 02 60 14
39 01 00 00 00 00 02 a0 00
39 01 00 00 00 00 02 a1 22
39 01 00 00 00 00 02 a2 37
39 01 00 00 00 00 02 a3 0F
39 01 00 00 00 00 02 a4 19
39 01 00 00 00 00 02 a5 27
39 01 00 00 00 00 02 a6 1C
39 01 00 00 00 00 02 a7 1E
39 01 00 00 00 00 02 a8 96
39 01 00 00 00 00 02 a9 19
39 01 00 00 00 00 02 aa 25
39 01 00 00 00 00 02 ab 83
39 01 00 00 00 00 02 ac 19
39 01 00 00 00 00 02 ad 18
39 01 00 00 00 00 02 ae 4F
39 01 00 00 00 00 02 af 22
39 01 00 00 00 00 02 b0 2A
39 01 00 00 00 00 02 b1 57
39 01 00 00 00 00 02 b2 64
39 01 00 00 00 00 02 b3 39
39 01 00 00 00 00 02 c0 00
39 01 00 00 00 00 02 c1 26
39 01 00 00 00 00 02 c2 2f
39 01 00 00 00 00 02 c3 19
39 01 00 00 00 00 02 c4 16
39 01 00 00 00 00 02 c5 2C
39 01 00 00 00 00 02 c6 1F
39 01 00 00 00 00 02 c7 1F
39 01 00 00 00 00 02 c8 98
39 01 00 00 00 00 02 c9 1D
39 01 00 00 00 00 02 ca 2A
39 01 00 00 00 00 02 cb 8C
39 01 00 00 00 00 02 cc 1D
39 01 00 00 00 00 02 cd 1C
39 01 00 00 00 00 02 ce 4D
39 01 00 00 00 00 02 cf 24
39 01 00 00 00 00 02 d0 28
39 01 00 00 00 00 02 d1 5F
39 01 00 00 00 00 02 d2 6D
39 01 00 00 00 00 02 d3 39
39 01 00 00 00 00 04 FF 98 81 00
05 01 00 00 78 00 02 11 00
05 01 00 00 0A 00 02 29 00
39 01 00 00 00 00 02 35 00];
		qcom,mdss-dsi-off-command = [05 01 00 00 32 00 02 28 00
					05 01 00 00 78 00 02 10 00];
		qcom,mdss-dsi-on-command-state = "dsi_lp_mode";
		qcom,mdss-dsi-off-command-state = "dsi_hs_mode";
		qcom,mdss-dsi-h-sync-pulse = <1>;
		qcom,mdss-dsi-traffic-mode = "non_burst_sync_pulse";
		qcom,mdss-dsi-lane-map = "lane_map_0123";
		qcom,mdss-dsi-bllp-eof-power-mode;
		qcom,mdss-dsi-bllp-power-mode;
		qcom,mdss-dsi-lane-0-state;
		qcom,mdss-dsi-lane-1-state;
		qcom,mdss-dsi-lane-2-state;
		qcom,mdss-dsi-lane-3-state;
		qcom,mdss-dsi-panel-timings = [82 1c 12 00 40 42 16 1E 14 03 04 00];
		qcom,mdss-dsi-t-clk-post = <0x04>;
		qcom,mdss-dsi-t-clk-pre = <0x1B>;
		qcom,mdss-dsi-bl-min-level = <1>;
		qcom,mdss-dsi-bl-max-level = <4095>;
		qcom,mdss-dsi-dma-trigger = "trigger_sw";
		qcom,mdss-dsi-mdp-trigger = "none";
		qcom,mdss-dsi-bl-pmic-pwm-frequency = <50>;
                qcom,mdss-dsi-bl-pmic-bank-select = <0>;
                qcom,mdss-dsi-pwm-gpio = <&pm8909_mpps 2 0>;
                qcom,mdss-dsi-bl-pmic-control-type = "bl_ctrl_pwm";
                qcom,mdss-dsi-reset-sequence = <1 20>, <0 2>, <1 20>;
                qcom,cont-splash-enabled;





	};
};
